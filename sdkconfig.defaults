## sdkconfig.defaults
```kconfig
CONFIG_ESPTOOLPY_FLASHSIZE_4MB=y

CONFIG_ESP_COREDUMP_ENABLE_TO_FLASH=y
CONFIG_ESP_COREDUMP_TO_FLASH_OR_UART=y
CONFIG_ESP_COREDUMP_DATA_FORMAT_ELF=y

CONFIG_LOG_MAXIMUM_LEVEL_DEBUG=y
CONFIG_LOG_DEFAULT_LEVEL_DEBUG=y

# websocket support
CONFIG_HTTPD_WS_SUPPORT=y
```
